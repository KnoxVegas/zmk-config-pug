## config/boards/shields/Pug/Kconfig.defconfig
```kconfig
if SHIELD_PUG_LEFT

config ZMK_KEYBOARD_NAME
    default "Pug"

config ZMK_SPLIT_ROLE_CENTRAL
    default y

endif

if SHIELD_PUG_LEFT || SHIELD_PUG_RIGHT

config ZMK_SPLIT
    default y

endif
```

## config/boards/shields/Pug/Kconfig.shield
```kconfig
config SHIELD_PUG_LEFT
    def_bool $(shields_list_contains,Pug_left)

config SHIELD_PUG_RIGHT
    def_bool $(shields_list_contains,Pug_right)
```
